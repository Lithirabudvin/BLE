## CMakeLists.txt
```
cmake_minimum_required(VERSION 3.20.0)
find_package(Zephyr REQUIRED HINTS $ENV{ZEPHYR_BASE})
project(BLE)

target_sources(app PRIVATE
    src/main.c
    src/ble_app.c
    src/ble_audio.c
    src/audio_capture.c
    src/ota.c
)

target_include_directories(app PRIVATE src)
```

## prj.conf
```kconfig
CONFIG_GPIO=y

# Bluetooth (name must stay <= 11 chars, see ble_app.c)
CONFIG_BT=y
CONFIG_BT_PERIPHERAL=y
CONFIG_BT_DEVICE_NAME="Feather-OTA"

# Throughput for audio streaming and faster OTA
CONFIG_BT_L2CAP_TX_MTU=247
CONFIG_BT_BUF_ACL_RX_SIZE=255
CONFIG_BT_BUF_ACL_TX_SIZE=251
CONFIG_BT_CTLR_DATA_LENGTH_MAX=251
CONFIG_BT_USER_DATA_LEN_UPDATE=y
CONFIG_BT_USER_PHY_UPDATE=y
CONFIG_BT_L2CAP_TX_BUF_COUNT=10
CONFIG_BT_BUF_ACL_TX_COUNT=16
CONFIG_BT_BUF_EVT_RX_COUNT=20
CONFIG_BT_CTLR_SDC_TX_PACKET_COUNT=16

# OTA: MCUboot + mcumgr over BLE
CONFIG_BOOTLOADER_MCUBOOT=y
CONFIG_ZCBOR=y
CONFIG_MCUMGR=y
CONFIG_MCUMGR_TRANSPORT_BT=y
CONFIG_MCUMGR_GRP_IMG=y
CONFIG_MCUMGR_GRP_OS=y
CONFIG_MCUMGR_TRANSPORT_NETBUF_SIZE=2048
CONFIG_IMG_MANAGER=y
CONFIG_STREAM_FLASH=y
CONFIG_FLASH=y
CONFIG_FLASH_MAP=y

# Audio capture (nrfx drivers used directly)
CONFIG_NRFX_SAADC=y
CONFIG_NRFX_TIMER=y

# Stacks (mcumgr runs on the system workqueue)
CONFIG_MAIN_STACK_SIZE=2048
CONFIG_SYSTEM_WORKQUEUE_STACK_SIZE=2048

# Logging
CONFIG_LOG=y
CONFIG_USE_SEGGER_RTT=y
CONFIG_LOG_BACKEND_RTT=y
CONFIG_LOG_MODE_IMMEDIATE=y

CONFIG_HW_STACK_PROTECTION=y
CONFIG_THREAD_STACK_INFO=y
CONFIG_STACK_SENTINEL=y

CONFIG_BT_GATT_CLIENT=y
CONFIG_BT_GATT_AUTO_UPDATE_MTU=y
CONFIG_BT_RX_STACK_SIZE=4096

CONFIG_BT_CTLR_SDC_MAX_CONN_EVENT_LEN_DEFAULT=15000
CONFIG_BT_CTLR_SDC_CONN_EVENT_EXTEND_DEFAULT=y

CONFIG_FPU=y
CONFIG_FPU_SHARING=y
```

## boards/adafruit_feather_nrf52840.overlay
```dts
&adc {
	status = "disabled";
};

&timer2 {
	status = "okay";
};
```

## boards/nrf52840dk_nrf52840.overlay
```dts
&timer1 {
    status = "okay";
};

&adc {
    status = "disabled";
};
```

## src/main.c
```c
#include <zephyr/kernel.h>
#include <zephyr/drivers/gpio.h>
#include <zephyr/logging/log.h>

#include "audio_capture.h"
#include "ble_app.h"
#include "ble_audio.h"
#include "ota.h" 

LOG_MODULE_REGISTER(app, LOG_LEVEL_INF);

#define LED_BLINK_MS 200

static const struct gpio_dt_spec led =
    GPIO_DT_SPEC_GET(DT_ALIAS(led0), gpios);

static void led_timer_fn(struct k_timer *timer)
{
    ARG_UNUSED(timer);
    gpio_pin_toggle_dt(&led);
}
K_TIMER_DEFINE(led_timer, led_timer_fn, NULL);

int main(void)
{
    int err;

    if (gpio_is_ready_dt(&led)) {
        gpio_pin_configure_dt(&led, GPIO_OUTPUT_INACTIVE);
        k_timer_start(&led_timer, K_MSEC(LED_BLINK_MS), K_MSEC(LED_BLINK_MS));
    } else {
        LOG_ERR("LED GPIO not ready");
    }

    /* BLE first: OTA keeps working even if audio fails to start. */
    err = ble_app_init();
    if (err) {
        LOG_ERR("BLE init failed: %d", err);
        return err;
    }

    err = ota_init();
    if (err) {
        LOG_WRN("OTA init failed: %d", err);
    }

    err = audio_capture_init();
    if (err) {
        LOG_ERR("Audio capture init failed: %d (BLE/OTA still running)", err);
        return 0;
    }

    static struct pcm_block blk;

    while (1) {
        if (audio_capture_get_block(&blk, K_FOREVER) != 0) {
            continue;
        }

        if (ble_audio_streaming() && ble_audio_send(&blk) == -ENOMEM) {
            LOG_WRN("PCM queue full, block dropped");
        }
    }

    return 0;
}
```

## src/audio_capture.c
```c
/*
 * Synthetic bowel-sound generator -- drop-in replacement for the
 * SAADC/piezo audio_capture.c (same API, sample rate and block size), so
 * main.c, ble_app.c and ble_audio.c need no changes.
 *
 * This is a TEST signal for exercising the BLE pipeline and the phone
 * display with something that looks and sounds like abdominal
 * auscultation. It is a rough approximation, not a physiological model.
 *
 * It mixes:
 *   - background: low-level band-limited noise (sensor / body noise floor)
 *   - bowel-sound events at random (Poisson) times, of the four types
 *     commonly used to classify bowel sounds:
 *       SB  single burst      one short click/pop, ~10-30 ms
 *       MB  multiple bursts   a train of 3-10 clicks with short gaps
 *       CRS continuous random sound: dense random clicks for 0.3-2 s
 *       HS  harmonic sound    a short tonal "gurgle" with harmonics
 *   - optional heartbeat thumps (a common interference on the abdomen)
 *
 * Each click is a damped sinusoid from a two-pole resonator
 *     y[n] = 2 r cos(w) y[n-1] - r^2 y[n-2]
 * kicked by a single impulse, which rings as A * r^n * sin(w (n+1)).
 * A small pool of these "voices" lets clicks overlap.
 *
 * REQUIRES THE FPU -- add to prj.conf:
 *     CONFIG_FPU=y
 *     CONFIG_FPU_SHARING=y
 *
 * Samples are generated in audio_capture_get_block() (thread context)
 * instead of the timer ISR, because the floating-point work does not
 * belong in an interrupt. The timer only counts out block periods; if the
 * consumer falls behind by up to MAX_PENDING_BLOCKS blocks it catches up
 * without losing any samples.
 *
 * Works at any AUDIO_SAMPLE_RATE_HZ >= 4000 (8000 is plenty: almost all
 * of this signal's energy is below 1.5 kHz).
 */

#include <math.h>

#include <zephyr/kernel.h>
#include <zephyr/logging/log.h>
#include <zephyr/sys/util.h>

#include "audio_capture.h"

LOG_MODULE_REGISTER(audio_capture, LOG_LEVEL_INF);

/* ---- Change these to shape the signal ---------------------------------- */

/* Average number of bowel-sound events per minute. Common clinical rules
 * of thumb put normal activity at roughly 5-35 per minute; try ~40+ for
 * "hyperactive" and ~3 for "hypoactive". */
#define EVENTS_PER_MIN        15.0f

/* Relative likelihood of each event type (any non-negative integers). */
#define WEIGHT_SB             45
#define WEIGHT_MB             25
#define WEIGHT_CRS            15
#define WEIGHT_HS             15

/* Overall level multiplier. At 1.0 the loudest clicks peak around half of
 * full scale. */
#define OUTPUT_GAIN           1.0f

/* Background noise floor: RMS as a fraction of full scale, and its upper
 * frequency limit. */
#define BACKGROUND_RMS        0.004f
#define BACKGROUND_CUTOFF_HZ  600.0f

/* Single burst (these frequency/decay ranges are also used for every click
 * of a multiple burst). */
#define SB_FREQ_MIN_HZ        200.0f
#define SB_FREQ_MAX_HZ        700.0f
#define SB_DECAY_MIN_MS       2.0f     /* ring-down time constant */
#define SB_DECAY_MAX_MS       6.0f
#define SB_AMP_MIN            0.15f
#define SB_AMP_MAX            0.50f

/* Multiple bursts. */
#define MB_CLICKS_MIN         3
#define MB_CLICKS_MAX         10
#define MB_GAP_MIN_MS         20.0f
#define MB_GAP_MAX_MS         150.0f
#define MB_AMP_MIN            0.10f
#define MB_AMP_MAX            0.35f

/* Continuous random sound. */
#define CRS_DUR_MIN_MS        300.0f
#define CRS_DUR_MAX_MS        2000.0f
#define CRS_SPACING_MIN_MS    3.0f
#define CRS_SPACING_MAX_MS    15.0f
#define CRS_FREQ_MIN_HZ       150.0f
#define CRS_FREQ_MAX_HZ       900.0f
#define CRS_DECAY_MIN_MS      1.5f
#define CRS_DECAY_MAX_MS      5.0f
#define CRS_AMP_MIN           0.03f
#define CRS_AMP_MAX           0.12f

/* Harmonic sound: fundamental plus 2nd and 3rd harmonics, with a slight
 * pitch glide and a "bubbling" amplitude flutter. */
#define HS_F0_MIN_HZ          150.0f
#define HS_F0_MAX_HZ          400.0f
#define HS_GLIDE              0.15f    /* max +/- pitch change over the sound */
#define HS_DUR_MIN_MS         100.0f
#define HS_DUR_MAX_MS         800.0f
#define HS_AMP_MIN            0.08f
#define HS_AMP_MAX            0.25f

/* Heartbeat thumps (S1 + S2 pairs). 0 = off, 1 = on. */
#define HEART_ENABLE          0
#define HEART_BPM             72.0f
#define HEART_LEVEL           0.03f

/* Same seed = same sequence of events after every reset. */
#define RANDOM_SEED           0x2545F491U

/* ------------------------------------------------------------------------ */

#define FS                    ((float)AUDIO_SAMPLE_RATE_HZ)
#define TWO_PI                6.28318531f
#define PI_F                  3.14159265f
#define NUM_VOICES            12
#define MAX_PENDING_BLOCKS    4

BUILD_ASSERT(AUDIO_SAMPLE_RATE_HZ >= 4000,
             "bowel-sound generator needs at least 4 kHz sampling");
BUILD_ASSERT(WEIGHT_SB + WEIGHT_MB + WEIGHT_CRS + WEIGHT_HS > 0,
             "at least one event type must have a non-zero weight");
BUILD_ASSERT(MB_CLICKS_MIN >= 1 && MB_CLICKS_MIN <= MB_CLICKS_MAX,
             "bad multiple-burst click range");

/* ---- Random numbers ----------------------------------------------------- */

static uint32_t rng_state = RANDOM_SEED;

static uint32_t rand_u32(void)
{
    uint32_t x = rng_state;

    x ^= x << 13;
    x ^= x >> 17;
    x ^= x << 5;
    rng_state = x;
    return x;
}

/* Uniform in [0, 1). */
static float rand_unit(void)
{
    return (float)(rand_u32() >> 8) * (1.0f / 16777216.0f);
}

static float rand_range(float lo, float hi)
{
    return lo + (hi - lo) * rand_unit();
}

static int rand_int(int lo, int hi)
{
    return lo + (int)(rand_u32() % (uint32_t)(hi - lo + 1));
}

static uint32_t ms_to_samples(float ms)
{
    return (uint32_t)(ms * FS / 1000.0f);
}

/* ---- Click voices (damped resonators) ---------------------------------- */

struct voice {
    float c1, c2;    /* 2 r cos(w), -r^2 */
    float y1, y2;    /* previous two outputs */
    float kick;      /* impulse applied on the next sample */
    uint32_t age;
    bool active;
};

static struct voice voices[NUM_VOICES];

static void voice_trigger(float freq_hz, float decay_ms, float amp)
{
    /* Take a free voice; if all are busy, steal the quietest one. */
    struct voice *v = &voices[0];
    float quietest = 1e9f;

    for (int i = 0; i < NUM_VOICES; i++) {
        if (!voices[i].active) {
            v = &voices[i];
            break;
        }
        float level = fabsf(voices[i].y1) + fabsf(voices[i].y2);

        if (level < quietest) {
            quietest = level;
            v = &voices[i];
        }
    }

    float w = TWO_PI * freq_hz / FS;
    float r = expf(-1000.0f / (decay_ms * FS));

    v->c1 = 2.0f * r * cosf(w);
    v->c2 = -r * r;
    v->y1 = 0.0f;
    v->y2 = 0.0f;
    v->kick = amp * sinf(w);   /* then rings as amp * r^n * sin(w (n+1)) */
    v->age = 0U;
    v->active = true;
}

static float voices_next(void)
{
    float sum = 0.0f;

    for (int i = 0; i < NUM_VOICES; i++) {
        struct voice *v = &voices[i];

        if (!v->active) {
            continue;
        }

        float y = v->c1 * v->y1 + v->c2 * v->y2 + v->kick;

        v->kick = 0.0f;
        v->y2 = v->y1;
        v->y1 = y;
        sum += y;

        /* Free the voice once it has rung down below ~3 LSB. */
        if (++v->age > 16U && (fabsf(v->y1) + fabsf(v->y2)) < 1e-4f) {
            v->active = false;
        }
    }

    return sum;
}

/* ---- Event scheduling --------------------------------------------------- */

enum seq_type { SEQ_NONE, SEQ_MB, SEQ_CRS };

static enum seq_type seq_state;
static int      seq_clicks_left;
static uint32_t seq_countdown;
static uint32_t seq_pos, seq_len;
static uint32_t idle_countdown;   /* samples until the next event starts */

static volatile uint32_t count_sb, count_mb, count_crs, count_hs;

/* Exponentially distributed gaps give Poisson-distributed event times:
 * irregular, with occasional clusters and occasional long silences. */
static uint32_t event_gap_samples(void)
{
    float mean_s = 60.0f / EVENTS_PER_MIN;
    float u = rand_unit();

    if (u < 1e-4f) {
        u = 1e-4f;
    }

    float gap_s = -mean_s * logf(u);

    if (gap_s < 0.05f) {
        gap_s = 0.05f;
    }

    return (uint32_t)(gap_s * FS);
}

static void event_finished(void)
{
    idle_countdown = event_gap_samples();
}

/* ---- Harmonic sound ----------------------------------------------------- */

static struct {
    bool active;
    float phase, f_start, f_end, amp;
    float am_phase, am_step;
    uint32_t pos, len, ramp;
} hs;

static float hs_next(void)
{
    if (!hs.active) {
        return 0.0f;
    }

    float t = (float)hs.pos / (float)hs.len;
    float f = hs.f_start + (hs.f_end - hs.f_start) * t;

    hs.phase += TWO_PI * f / FS;
    if (hs.phase >= TWO_PI) {
        hs.phase -= TWO_PI;
    }
    hs.am_phase += hs.am_step;
    if (hs.am_phase >= TWO_PI) {
        hs.am_phase -= TWO_PI;
    }

    float p = hs.phase;
    float s = (sinf(p) + 0.5f * sinf(2.0f * p) + 0.25f * sinf(3.0f * p))
              * (1.0f / 1.75f);

    float env = 1.0f;

    if (hs.pos < hs.ramp) {
        env = (float)hs.pos / (float)hs.ramp;
    } else if (hs.len - hs.pos < hs.ramp) {
        env = (float)(hs.len - hs.pos) / (float)hs.ramp;
    }
    env *= 0.75f + 0.25f * sinf(hs.am_phase);   /* bubbling flutter */

    if (++hs.pos >= hs.len) {
        hs.active = false;
        event_finished();
    }

    return hs.amp * env * s;
}

/* ---- Starting events ---------------------------------------------------- */

static void start_event(void)
{
    const int total = WEIGHT_SB + WEIGHT_MB + WEIGHT_CRS + WEIGHT_HS;
    int pick = rand_int(0, total - 1);

    if ((pick -= WEIGHT_SB) < 0) {
        float f = rand_range(SB_FREQ_MIN_HZ, SB_FREQ_MAX_HZ);

        voice_trigger(f, rand_range(SB_DECAY_MIN_MS, SB_DECAY_MAX_MS),
                      rand_range(SB_AMP_MIN, SB_AMP_MAX));
        count_sb++;
        LOG_INF("Event SB: %d Hz", (int)f);
        event_finished();

    } else if ((pick -= WEIGHT_MB) < 0) {
        seq_state = SEQ_MB;
        seq_clicks_left = rand_int(MB_CLICKS_MIN, MB_CLICKS_MAX);
        seq_countdown = 0U;
        count_mb++;
        LOG_INF("Event MB: %d clicks", seq_clicks_left);

    } else if ((pick -= WEIGHT_CRS) < 0) {
        seq_state = SEQ_CRS;
        seq_pos = 0U;
        seq_len = ms_to_samples(rand_range(CRS_DUR_MIN_MS, CRS_DUR_MAX_MS));
        seq_countdown = 0U;
        count_crs++;
        LOG_INF("Event CRS: %d ms", (int)(seq_len * 1000U / AUDIO_SAMPLE_RATE_HZ));

    } else {
        hs.f_start = rand_range(HS_F0_MIN_HZ, HS_F0_MAX_HZ);
        hs.f_end = hs.f_start * (1.0f + rand_range(-HS_GLIDE, HS_GLIDE));
        hs.amp = rand_range(HS_AMP_MIN, HS_AMP_MAX);
        hs.len = ms_to_samples(rand_range(HS_DUR_MIN_MS, HS_DUR_MAX_MS));
        hs.ramp = MIN(ms_to_samples(20.0f), hs.len / 4U);
        hs.pos = 0U;
        hs.phase = 0.0f;
        hs.am_phase = 0.0f;
        hs.am_step = TWO_PI * rand_range(6.0f, 15.0f) / FS;
        hs.active = true;
        count_hs++;
        LOG_INF("Event HS: %d Hz, %d ms", (int)hs.f_start,
                (int)(hs.len * 1000U / AUDIO_SAMPLE_RATE_HZ));
    }
}

static void scheduler_tick(void)
{
    switch (seq_state) {
    case SEQ_MB:
        if (seq_countdown > 0U) {
            seq_countdown--;
            break;
        }
        voice_trigger(rand_range(SB_FREQ_MIN_HZ, SB_FREQ_MAX_HZ),
                      rand_range(SB_DECAY_MIN_MS, SB_DECAY_MAX_MS),
                      rand_range(MB_AMP_MIN, MB_AMP_MAX));
        if (--seq_clicks_left <= 0) {
            seq_state = SEQ_NONE;
            event_finished();
        } else {
            seq_countdown = ms_to_samples(rand_range(MB_GAP_MIN_MS, MB_GAP_MAX_MS));
        }
        break;

    case SEQ_CRS:
        if (seq_countdown > 0U) {
            seq_countdown--;
        } else {
            /* Smooth rise and fall over the whole sound. */
            float env = sinf(PI_F * (float)seq_pos / (float)seq_len);

            voice_trigger(rand_range(CRS_FREQ_MIN_HZ, CRS_FREQ_MAX_HZ),
                          rand_range(CRS_DECAY_MIN_MS, CRS_DECAY_MAX_MS),
                          env * rand_range(CRS_AMP_MIN, CRS_AMP_MAX));
            seq_countdown = ms_to_samples(rand_range(CRS_SPACING_MIN_MS,
                                                     CRS_SPACING_MAX_MS));
        }
        if (++seq_pos >= seq_len) {
            seq_state = SEQ_NONE;
            event_finished();
        }
        break;

    case SEQ_NONE:
    default:
        if (hs.active) {
            break;              /* a harmonic sound is still playing */
        }
        if (idle_countdown > 0U) {
            idle_countdown--;
        } else {
            start_event();
        }
        break;
    }
}

/* ---- Heartbeat ---------------------------------------------------------- */

#if HEART_ENABLE
static uint32_t heart_countdown;
static uint32_t heart_s2_countdown;

static void heart_tick(void)
{
    if (heart_countdown == 0U) {
        voice_trigger(rand_range(40.0f, 60.0f), 30.0f, HEART_LEVEL);          /* S1 */
        heart_s2_countdown = ms_to_samples(300.0f);
        heart_countdown = (uint32_t)(60.0f / HEART_BPM * FS);
    } else {
        heart_countdown--;
    }

    if (heart_s2_countdown > 0U && --heart_s2_countdown == 0U) {
        voice_trigger(rand_range(50.0f, 70.0f), 20.0f, HEART_LEVEL * 0.7f);   /* S2 */
    }
}
#endif

/* ---- Background noise --------------------------------------------------- */

static float bg_state, bg_alpha, bg_gain;

static float background_next(void)
{
    float n = rand_unit() * 2.0f - 1.0f;

    bg_state += bg_alpha * (n - bg_state);   /* one-pole low-pass */
    return bg_state * bg_gain;
}

/* ---- Sample output ------------------------------------------------------ */

static volatile uint32_t clip_count;

static int16_t next_sample(void)
{
    scheduler_tick();
#if HEART_ENABLE
    heart_tick();
#endif

    float x = (voices_next() + hs_next() + background_next()) * OUTPUT_GAIN;
    int32_t s = (int32_t)(x * 32767.0f);

    if (s > 32767) {
        s = 32767;
        clip_count++;
    } else if (s < -32768) {
        s = -32768;
        clip_count++;
    }

    return (int16_t)s;
}

/* ---- Block timing --------------------------------------------------------- */

/* The timer only counts block periods; samples are made in thread context. */
K_SEM_DEFINE(block_sem, 0, MAX_PENDING_BLOCKS);
static volatile uint32_t overrun_count;

static void gen_timer_handler(struct k_timer *timer)
{
    ARG_UNUSED(timer);

    if (k_sem_count_get(&block_sem) >= MAX_PENDING_BLOCKS) {
        overrun_count++;    /* consumer is more than MAX_PENDING_BLOCKS behind */
    }
    k_sem_give(&block_sem);
}

K_TIMER_DEFINE(gen_timer, gen_timer_handler, NULL);

int audio_capture_init(void)
{
    /* Normalise the background so its RMS equals BACKGROUND_RMS:
     * uniform noise has RMS 1/sqrt(3), and a one-pole low-pass scales it
     * by sqrt(a / (2 - a)). */
    bg_alpha = 1.0f - expf(-TWO_PI * BACKGROUND_CUTOFF_HZ / FS);
    bg_gain = BACKGROUND_RMS / (0.57735f * sqrtf(bg_alpha / (2.0f - bg_alpha)));
    bg_state = 0.0f;

    seq_state = SEQ_NONE;
    hs.active = false;
    idle_countdown = event_gap_samples();

    LOG_INF("Synthetic bowel sounds: ~%d events/min (SB %d, MB %d, CRS %d, HS %d), "
            "heart %s, %d Hz sample rate, block %d samples",
            (int)EVENTS_PER_MIN, WEIGHT_SB, WEIGHT_MB, WEIGHT_CRS, WEIGHT_HS,
            HEART_ENABLE ? "on" : "off", AUDIO_SAMPLE_RATE_HZ, AUDIO_BLOCK_SAMPLES);

    k_timer_start(&gen_timer, K_NO_WAIT,
                  K_MSEC(1000ULL * AUDIO_BLOCK_SAMPLES / AUDIO_SAMPLE_RATE_HZ));

    return 0;
}

int audio_capture_get_block(struct pcm_block *blk, k_timeout_t timeout)
{
    static uint32_t block_count;
    static int16_t window_min = INT16_MAX;
    static int16_t window_max = INT16_MIN;

    if (k_sem_take(&block_sem, timeout) != 0) {
        return -EAGAIN;
    }

    for (int i = 0; i < AUDIO_BLOCK_SAMPLES; i++) {
        int16_t s = next_sample();

        blk->s[i] = s;
        if (s < window_min) {
            window_min = s;
        }
        if (s > window_max) {
            window_max = s;
        }
    }

    /* Summary about once per second (at 16 kHz; every ~2 s at 8 kHz). */
    if ((++block_count % 16U) == 0U) {
        LOG_INF("Bowel sim: min=%d max=%d | SB=%u MB=%u CRS=%u HS=%u | "
                "clipped=%u overruns=%u",
                window_min, window_max, count_sb, count_mb, count_crs,
                count_hs, clip_count, overrun_count);
        window_min = INT16_MAX;
        window_max = INT16_MIN;
    }

    return 0;
}
```

## src/audio_capture.h
```c
#ifndef AUDIO_CAPTURE_H
#define AUDIO_CAPTURE_H

#include <stdint.h>
#include <zephyr/kernel.h>

#define AUDIO_SAMPLE_RATE_HZ  16000
#define AUDIO_BLOCK_SAMPLES   960                        /* 60 ms */
#define AUDIO_BLOCK_BYTES     (AUDIO_BLOCK_SAMPLES * 2)

struct pcm_block {
    int16_t s[AUDIO_BLOCK_SAMPLES];
};

/* Start SAADC + TIMER2 + PPI sampling (mono, 16 kHz). Returns 0 or -errno. */
int audio_capture_init(void);

/* Wait for the next block; DC removal and gain are already applied.
 * Returns 0 on success, -EAGAIN on timeout. */
int audio_capture_get_block(struct pcm_block *blk, k_timeout_t timeout);

#endif /* AUDIO_CAPTURE_H */
```

## src/ble_app.c
```c
/*
 * BLE core: enable stack, advertise, track the connection.
 * Shared by the audio streaming service and the OTA (SMP) service.
 *
 * Advertising packets are limited to 31 bytes, so:
 *   adv data      : flags (3) + audio service UUID128 (18)      = 21 bytes
 *   scan response : SMP service UUID128 (18) + name (2 + len)
 * The name therefore has to be 11 characters or fewer.
 */

#include <zephyr/kernel.h>
#include <zephyr/bluetooth/bluetooth.h>
#include <zephyr/bluetooth/conn.h>
#include <zephyr/bluetooth/gatt.h>
#include <zephyr/bluetooth/hci.h>
#include <zephyr/logging/log.h>

#include "ble_app.h"
#include "ble_audio.h"
#include "ota.h"

static struct k_work_delayable tune_work;
static int tune_step;

/*
 * The tune sequence above runs ONCE per connection and then stops. That's
 * fine for MTU/DLE/PHY, which only need to be set once -- but the central
 * (Android in particular) can re-open connection-parameter negotiation on
 * its OWN schedule at any later point in the connection, independent of
 * anything we request. Each log has shown the interval drifting back up
 * minutes after our one-shot request already succeeded -- that's the
 * central doing this, not our firmware failing to ask.
 *
 * This watchdog re-asks for the fast interval every time le_param_updated()
 * reports something slower than we want, for as long as the connection
 * lasts, instead of giving up after the first attempt.
 */
#define DESIRED_INTERVAL_MAX_UNITS  6   /* 6 * 1.25ms = 7.5 ms */

static struct k_work_delayable retune_work;

LOG_MODULE_REGISTER(ble_app, LOG_LEVEL_INF);

static struct bt_conn *current_conn;

static const struct bt_data ad[] = {
    BT_DATA_BYTES(BT_DATA_FLAGS, (BT_LE_AD_GENERAL | BT_LE_AD_NO_BREDR)),
    BT_DATA_BYTES(BT_DATA_UUID128_ALL, BT_UUID_AUDIO_SERVICE_VAL),
};

static const struct bt_data sd[] = {
    BT_DATA_BYTES(BT_DATA_UUID128_ALL, OTA_SMP_UUID_VAL),
    BT_DATA(BT_DATA_NAME_COMPLETE, CONFIG_BT_DEVICE_NAME,
            sizeof(CONFIG_BT_DEVICE_NAME) - 1),
};

static int start_advertising(void)
{
    return bt_le_adv_start(BT_LE_ADV_CONN_FAST_2, ad, ARRAY_SIZE(ad),
                           sd, ARRAY_SIZE(sd));
}

static void mtu_updated(struct bt_conn *conn, uint16_t tx, uint16_t rx)
{
    ARG_UNUSED(conn);
    LOG_INF("MTU updated: TX=%u RX=%u", tx, rx);
}

static struct bt_gatt_cb gatt_callbacks = {
    .att_mtu_updated = mtu_updated,
};

/*
 * ATT MTU exchange. The MTU can only be negotiated ONCE per connection,
 * and it stays at the 23-byte default forever if neither side asks for
 * more. Many BLE centrals (test tools, nRF Connect for Desktop, some
 * generic scanners) never request a bigger MTU on their own -- so the
 * peripheral has to ask. Requesting it here, immediately on connect,
 * also wins the race against a central that only exchanges MTU later
 * (e.g. only when you click a button in a desktop tool), since a second
 * exchange attempt after one has already completed is simply rejected.
 *
 * At MTU=23 a notification can carry only 18 payload bytes, so a 1920
 * byte audio block needs ~107 notifications -- far more than fit in the
 * time budget, which is what caused the "PCM queue full" drops. Once
 * this succeeds the sender in ble_audio.c automatically starts using
 * the bigger payload (it reads bt_gatt_get_mtu() per packet already).
 */
static struct bt_gatt_exchange_params mtu_exchange_params;

static void mtu_exchange_cb(struct bt_conn *conn, uint8_t err,
                            struct bt_gatt_exchange_params *params)
{
    ARG_UNUSED(params);

    if (err) {
        LOG_WRN("MTU exchange failed (err %u), staying at %u bytes",
                err, bt_gatt_get_mtu(conn));
    } else {
        LOG_INF("MTU exchange accepted, now %u bytes", bt_gatt_get_mtu(conn));
    }
}

static void request_mtu_exchange(struct bt_conn *conn)
{
    mtu_exchange_params.func = mtu_exchange_cb;

    int err = bt_gatt_exchange_mtu(conn, &mtu_exchange_params);

    if (err) {
        /* -EALREADY here just means the central already exchanged MTU
         * before we asked (e.g. during service discovery) -- harmless,
         * whatever value resulted is what we're stuck with. */
        LOG_WRN("MTU exchange request failed: %d", err);
    }
}

static void connected(struct bt_conn *conn, uint8_t err)
{
    if (err) {
        LOG_ERR("Connection failed (err %u)", err);
        return;
    }
    LOG_INF("Connected");
    current_conn = bt_conn_ref(conn);

    /* Ask for a bigger MTU right away -- see request_mtu_exchange(). */
    request_mtu_exchange(conn);

    /* Data length / PHY / connection interval tuning, run as a short
     * sequence with a small gap between steps rather than all at once,
     * since a BLE controller can only have one such procedure active
     * per connection at a time. Starts almost immediately now (used to
     * wait a full 2 s first) so audio has less time to overrun the
     * queue before the link is tuned. */
    tune_step = 0;
    k_work_reschedule(&tune_work, K_MSEC(300));
}

static void disconnected(struct bt_conn *conn, uint8_t reason)
{
    ARG_UNUSED(conn);
    LOG_INF("Disconnected (reason %u)", reason);

    k_work_cancel_delayable(&tune_work);
    k_work_cancel_delayable(&retune_work);

    if (current_conn) {
        bt_conn_unref(current_conn);
        current_conn = NULL;
    }
}

static void tune_fn(struct k_work *w)
{
    ARG_UNUSED(w);
    if (!current_conn) {
        return;
    }

    int e = 0;

    switch (tune_step++) {
    case 0: e = bt_conn_le_data_len_update(current_conn, BT_LE_DATA_LEN_PARAM_MAX); break;
    case 1: e = bt_conn_le_phy_update(current_conn, BT_CONN_LE_PHY_PARAM_2M); break;
    case 2: e = bt_conn_le_param_update(current_conn, BT_LE_CONN_PARAM(6, 12, 0, 400)); break;
    default: return;
    }
    if (e) {
        LOG_WRN("Link tuning step %d failed: %d", tune_step - 1, e);
    }
    k_work_reschedule(&tune_work, K_MSEC(500));
}

static void retune_fn(struct k_work *w)
{
    ARG_UNUSED(w);

    if (!current_conn) {
        return;
    }

    /* Same pinned request tune_fn's step 2 used -- ask again, since the
     * central has drifted away from it on its own. */
    int e = bt_conn_le_param_update(current_conn, BT_LE_CONN_PARAM(6, 6, 0, 400));

    if (e) {
        LOG_WRN("Re-tune param update failed: %d", e);
    } else {
        LOG_INF("Central drifted off the fast interval -- re-requested it");
    }
}

static void recycled(void)
{
    int err = start_advertising();

    if (err) {
        LOG_ERR("Re-advertising failed: %d", err);
    } else {
        LOG_INF("Advertising restarted");
    }
}

static void le_phy_updated(struct bt_conn *conn,
                           struct bt_conn_le_phy_info *param)
{
    ARG_UNUSED(conn);
    LOG_INF("PHY: TX %u RX %u (1=1M, 2=2M)", param->tx_phy, param->rx_phy);
}

static void le_param_updated(struct bt_conn *conn, uint16_t interval,
                             uint16_t latency, uint16_t timeout)
{
    ARG_UNUSED(conn);
    LOG_INF("Conn params: interval %u.%02u ms, latency %u, timeout %u ms",
            (interval * 5U) / 4U, ((interval * 5U) % 4U) * 25U,
            latency, timeout * 10U);

    if (interval > DESIRED_INTERVAL_MAX_UNITS) {
        /* Give the central a few seconds in case this is part of its own
         * settling process, then ask again. Runs for as long as the
         * connection lasts -- unlike the one-shot tune sequence, this
         * keeps correcting drift for the whole session. */
        k_work_reschedule(&retune_work, K_SECONDS(3));
    }
}

static void le_data_len_updated(struct bt_conn *conn,
                                struct bt_conn_le_data_len_info *info)
{
    ARG_UNUSED(conn);
    LOG_INF("DLE: TX %u B/%u us, RX %u B/%u us",
            info->tx_max_len, info->tx_max_time,
            info->rx_max_len, info->rx_max_time);
}

BT_CONN_CB_DEFINE(conn_callbacks) = {
    .connected           = connected,
    .disconnected        = disconnected,
    .recycled            = recycled,
    .le_phy_updated      = le_phy_updated,
    .le_param_updated    = le_param_updated,
    .le_data_len_updated = le_data_len_updated,
};

struct bt_conn *ble_app_get_conn(void)
{
    return current_conn;
}

int ble_app_init(void)
{
    k_work_init_delayable(&tune_work, tune_fn);
    k_work_init_delayable(&retune_work, retune_fn);

    int err = bt_enable(NULL);
    LOG_INF("bt_enable: %d", err);
    if (err) {
        return err;
    }

    bt_gatt_cb_register(&gatt_callbacks);

    err = start_advertising();
    LOG_INF("adv_start: %d", err);
    return err;
}
```

## src/ble_app.h
```c
#ifndef BLE_APP_H
#define BLE_APP_H

#include <zephyr/bluetooth/conn.h>

/* bt_enable(), connection callbacks, advertising (audio + SMP/OTA UUIDs).
 * Call once from main(). Returns 0 or a negative error code. */
int ble_app_init(void);

/* Current connection, or NULL when not connected. */
struct bt_conn *ble_app_get_conn(void);

#endif /* BLE_APP_H */
```

## src/ble_audio.c
```c
/*
 * Audio GATT service: one notify characteristic streaming raw PCM.
 * A dedicated thread splits each block into MTU-sized notifications.
 * The service and thread are defined statically, so there is no init call.
 */

#include <string.h>

#include <zephyr/kernel.h>
#include <zephyr/sys/byteorder.h>
#include <zephyr/sys/util.h>
#include <zephyr/bluetooth/bluetooth.h>
#include <zephyr/bluetooth/conn.h>
#include <zephyr/bluetooth/gatt.h>
#include <zephyr/logging/log.h>

#include "ble_app.h"
#include "ble_audio.h"

LOG_MODULE_REGISTER(ble_audio, LOG_LEVEL_INF);

/* ~1 s of buffering at one 960-sample (60 ms) block per slot. Gives the
 * MTU/data-length/PHY/conn-param negotiation in ble_app.c (now started
 * immediately on connect, taking roughly 300-1500 ms) enough headroom to
 * finish without dropping blocks, without holding excess audio latency
 * once the link is tuned and draining at full speed. 16 blocks * 1920
 * bytes = ~30 KB, fine on the nRF52840's 256 KB RAM. */
#define QUEUE_DEPTH  16
#define MAX_PAYLOAD  240      /* max sample bytes per notification */

static struct bt_uuid_128 audio_service_uuid =
    BT_UUID_INIT_128(BT_UUID_AUDIO_SERVICE_VAL);
static struct bt_uuid_128 audio_char_uuid =
    BT_UUID_INIT_128(BT_UUID_AUDIO_CHAR_VAL);

K_MSGQ_DEFINE(pcm_q, sizeof(struct pcm_block), QUEUE_DEPTH, 4);

static volatile bool notify_enabled;
static uint16_t seq;

/* Ground-truth throughput measurement: logs the achieved notification
 * rate once a second, independent of any Kconfig/interval theory.
 * Compare this directly against the 133.3/sec (8 notifications *
 * 16.67 blocks/sec) the audio actually needs. */
static uint32_t notify_count;
static int64_t rate_window_start;

static void audio_ccc_cfg_changed(const struct bt_gatt_attr *attr,
                                  uint16_t value)
{
    ARG_UNUSED(attr);

    bool enable = (value == BT_GATT_CCC_NOTIFY);

    if (enable) {
        seq = 0;
        k_msgq_purge(&pcm_q);
    }
    notify_enabled = enable;
    LOG_INF("Notifications %s", enable ? "enabled" : "disabled");
}

BT_GATT_SERVICE_DEFINE(audio_svc,
    BT_GATT_PRIMARY_SERVICE(&audio_service_uuid),
    BT_GATT_CHARACTERISTIC(&audio_char_uuid.uuid,
                           BT_GATT_CHRC_NOTIFY,
                           BT_GATT_PERM_NONE,
                           NULL, NULL, NULL),
    BT_GATT_CCC(audio_ccc_cfg_changed,
                BT_GATT_PERM_READ | BT_GATT_PERM_WRITE),
);

static void audio_disconnected(struct bt_conn *conn, uint8_t reason)
{
    ARG_UNUSED(conn);
    ARG_UNUSED(reason);
    notify_enabled = false;
}

BT_CONN_CB_DEFINE(audio_conn_callbacks) = {
    .disconnected = audio_disconnected,
};

bool ble_audio_streaming(void)
{
    return notify_enabled && (ble_app_get_conn() != NULL);
}

int ble_audio_send(const struct pcm_block *blk)
{
    if (!ble_audio_streaming()) {
        return -ENOTCONN;
    }
    if (k_msgq_put(&pcm_q, blk, K_NO_WAIT) != 0) {
        return -ENOMEM;
    }
    return 0;
}

static void sender_thread(void *a, void *b, void *c)
{
    ARG_UNUSED(a);
    ARG_UNUSED(b);
    ARG_UNUSED(c);

    static struct pcm_block blk;
    uint8_t pkt[2 + MAX_PAYLOAD];

    rate_window_start = k_uptime_get();

    while (1) {
        k_msgq_get(&pcm_q, &blk, K_FOREVER);

        const uint8_t *p = (const uint8_t *)blk.s;
        size_t left = AUDIO_BLOCK_BYTES;

        while (left > 0) {
            struct bt_conn *conn = ble_app_get_conn();

            if (conn == NULL || !notify_enabled) {
                break;                      /* drop rest of this block */
            }

            uint16_t mtu = bt_gatt_get_mtu(conn);
            size_t max_payload = (mtu > 5U) ? (size_t)(mtu - 3U - 2U) : 0U;

            max_payload = MIN(max_payload, (size_t)MAX_PAYLOAD);
            max_payload &= ~1U;             /* whole 16-bit samples only */

            if (max_payload == 0U) {
                k_msleep(10);
                continue;
            }

            size_t n = MIN(left, max_payload);

            sys_put_le16(seq, pkt);
            memcpy(&pkt[2], p, n);

            int err = bt_gatt_notify(conn, &audio_svc.attrs[2], pkt, n + 2);

            if (err == -ENOMEM) {
                k_msleep(2);                /* TX buffers full, retry */
                continue;
            }
            if (err) {
                LOG_WRN("bt_gatt_notify failed: %d", err);
                break;
            }

            seq++;
            p += n;
            left -= n;

            notify_count++;
            int64_t now = k_uptime_get();

            if ((now - rate_window_start) >= 1000) {
                LOG_INF("Notification rate: %u/sec (need ~133/sec for real-time)",
                        notify_count);
                notify_count = 0;
                rate_window_start = now;
            }
        }
    }
}

K_THREAD_DEFINE(sender_tid, 4096, sender_thread, NULL, NULL, NULL, 7, 0, 0);
```

## src/ble_audio.h
```c
#ifndef BLE_AUDIO_H
#define BLE_AUDIO_H

#include <stdbool.h>
#include <zephyr/bluetooth/uuid.h>

#include "audio_capture.h"

#define BT_UUID_AUDIO_SERVICE_VAL \
    BT_UUID_128_ENCODE(0x12345678, 0x1234, 0x1234, 0x1234, 0x123456789abc)
#define BT_UUID_AUDIO_CHAR_VAL \
    BT_UUID_128_ENCODE(0x12345678, 0x1234, 0x1234, 0x1234, 0x123456789abd)

/* True while a client is connected and has enabled notifications. */
bool ble_audio_streaming(void);

/* Queue one PCM block for the sender thread.
 * Returns 0, -ENOTCONN (nobody listening) or -ENOMEM (queue full). */
int ble_audio_send(const struct pcm_block *blk);

/*
 * Notification format (each packet):
 *   bytes 0..1 : uint16 little-endian sequence number
 *   bytes 2..n : int16 little-endian samples (mono, 16 kHz)
 */

#endif /* BLE_AUDIO_H */
```

## src/ota.c
```c
#include <zephyr/kernel.h>
#include <zephyr/dfu/mcuboot.h>
#include <zephyr/logging/log.h>

#include "ota.h"

LOG_MODULE_REGISTER(ota, LOG_LEVEL_INF);

int ota_init(void)
{
    /* Confirm this image. If you would rather only confirm after the
     * firmware has proven itself (e.g. audio started OK), move this call
     * to that point so a bad update can still roll back. */
    int err = boot_write_img_confirmed();

    if (err) {
        LOG_ERR("boot_write_img_confirmed failed: %d", err);
        return err;
    }

    LOG_INF("Image confirmed, OTA (SMP over BLE) ready");
    return 0;
}
```

## src/ota.h
```c
#ifndef OTA_H
#define OTA_H

#include <zephyr/mgmt/mcumgr/transport/smp_bt.h>

/* SMP service UUID, advertised so nRF Device Manager can find the device. */
#define OTA_SMP_UUID_VAL  SMP_BT_SVC_UUID_VAL

/* Call after ble_app_init(). Marks the running image as good so MCUboot
 * doesn't roll back. The SMP/mcumgr service itself is registered
 * automatically by CONFIG_MCUMGR_TRANSPORT_BT. Returns 0 or -errno. */
int ota_init(void);

#endif /* OTA_H */
```
